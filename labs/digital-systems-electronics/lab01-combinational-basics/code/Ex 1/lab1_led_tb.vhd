LIBRARY ieee;
USE ieee.std_logic_1164.all;

ENTITY lab1_led_tb IS
END lab1_led_tb;

ARCHITECTURE pier OF lab1_led_tb IS 

 SIGNAL XIN, XOUT: STD_LOGIC_VECTOR(9 DOWNTO 0);
 
 COMPONENT part1
  PORT ( SW: IN STD_LOGIC_VECTOR(9 DOWNTO 0);
         LEDR: OUT STD_LOGIC_VECTOR(9 DOWNTO 0));
 END COMPONENT;

BEGIN
 uut: part1 PORT MAP (SW => XIN, LEDR => XOUT);
 PROCESS
  BEGIN
  XIN <= "0000000000";
  WAIT FOR 200 ns;
  XIN <= "0000000001";
  WAIT FOR 200 ns;
  XIN <= "0000000010";
  WAIT FOR 200 ns;
  XIN <= "0000000100";
  WAIT FOR 200 ns;
  XIN <= "0000001000";
  WAIT FOR 200 ns;
  XIN <= "0000010000";
  WAIT FOR 200 ns;
  XIN <= "0000100000";
  WAIT FOR 200 ns;
  XIN <= "0001000000";
  WAIT FOR 200 ns;
  XIN <= "0010000000";
  WAIT FOR 200 ns;
  XIN <= "0100000000";
  WAIT FOR 200 ns;
  XIN <= "1000000000";
  WAIT;
 END PROCESS;
 
END ARCHITECTURE;