library ieee;
use ieee.std_logic_1164.all;
use work.myTypes.all;

entity our_cu is
    port (
        -- control signals for STAGE 1
        EN1    : out std_logic;
        RF1    : out std_logic;
        RF2    : out std_logic;
        WF1    : out std_logic;
        
        -- control signals for STAGE 2
        EN2    : out std_logic;
        S1     : out std_logic;
        S2     : out std_logic;
        ALU1   : out std_logic;
        ALU2   : out std_logic;
        
        -- control signals for STAGE 3
        EN3    : out std_logic;
        RM     : out std_logic;
        WM     : out std_logic;
        S3     : out std_logic;
        
        -- inputs from datapath
        OPCODE : in  std_logic_vector(OP_CODE_SIZE - 1 downto 0);
        FUNC   : in  std_logic_vector(FUNC_SIZE - 1 downto 0);              
        Clk    : in  std_logic;
        Rst    : in  std_logic
    );
end entity;

architecture behaviour of our_cu is

    -- combinational signals generated by the LUT
    signal c_en   : std_logic_vector(2 downto 0); 
    signal c_s    : std_logic_vector(2 downto 0); 
    signal c_alu1, c_alu2 : std_logic;
    signal c_rf1, c_rf2, c_wf1, c_wm, c_rm : std_logic;

    -- pipeline registers for STAGE 2
    signal r1_en2, r1_en3 : std_logic;
    signal r1_s1, r1_s2, r1_s3 : std_logic;
    signal r1_alu1, r1_alu2 : std_logic;
    signal r1_rm, r1_wm : std_logic;

    -- pipeline registers for STAGE 3
    signal r2_en3 : std_logic;
    signal r2_s3  : std_logic;
    signal r2_rm, r2_wm : std_logic;

begin  

-- PROCESS 1: LUT (combinational)
-- generates thecontrol signals based on OPCODE and FUNC values.

LUT: process(OPCODE, FUNC)
begin
    -- default values
    c_en   <= "111"; -- all stages of the pipeline are initilized enabled
    c_rf1  <= '0';
    c_rf2  <= '0';
    c_s(0) <= '0';  
    c_s(1) <= '0';
    c_s(2) <= '0';
    c_wf1  <= '0';
    c_rm   <= '0'; 
    c_wm   <= '0';
    c_alu1 <= '0';
    c_alu2 <= '0';  
 
    case OPCODE is
        
        -- reg to reg operations
        when RTYPE =>

        c_rf1<='1'; -- Read RA
	c_rf2<='1'; -- Read RB
	c_wf1<='1'; -- Write result back to RC
	c_s(0)<='0'; -- Mux1 selects RA
	c_s(1)<='1'; -- Mux2 selects RB
	c_rm<='0';	 -- No memory read
	c_wm<='0';	 -- No memory write
	 
            -- ALU operation selection based on FUNC field
            if FUNC = RTYPE_ADD then c_alu1 <= '0'; c_alu2 <= '0';      -- ADD
            elsif FUNC = RTYPE_SUB then c_alu1 <= '0'; c_alu2 <= '1';   -- SUB
            elsif FUNC = RTYPE_AND then c_alu1 <= '1'; c_alu2 <= '0';   -- AND
            elsif FUNC = RTYPE_OR then c_alu1 <= '1'; c_alu2 <= '1';    -- OR
            end if;
  
        -- R[RA] = R[RB] + INP1
        when ITYPE_ADDI1 =>
            c_rf1  <= '0'; c_rf2  <= '1'; c_wf1  <= '1'; -- Read RB, Write RA
            c_s(0) <= '1'; c_s(1) <= '0';                -- Mux1=INP1, Mux2=RB
            c_alu1 <= '0'; c_alu2 <= '0';                -- ADD

        -- R[RA] = R[RB] - INP1
        when ITYPE_SUBI1 =>
            c_rf1  <= '0'; c_rf2  <= '1'; c_wf1  <= '1'; -- Read RB, Write RA
            c_s(0) <= '1'; c_s(1) <= '0';                -- Mux1=INP1, Mux2=RB
            c_alu1 <= '0'; c_alu2 <= '1';                -- SUB

        -- R[RA] = R[RB] AND INP1
        when ITYPE_ANDI1 =>
            c_rf1  <= '0'; c_rf2  <= '1'; c_wf1  <= '1'; -- Read RB, Write RA
            c_s(0) <= '1'; c_s(1) <= '0';                -- Mux1=INP1, Mux2=RB
            c_alu1 <= '1'; c_alu2 <= '0';                -- AND

        -- R[RA] = R[RB] OR INP1
        when ITYPE_ORI1 =>
            c_rf1  <= '0'; c_rf2  <= '1'; c_wf1  <= '1'; -- Read RB, Write RA
            c_s(0) <= '1'; c_s(1) <= '0';                -- Mux1=INP1, Mux2=RB
            c_alu1 <= '1'; c_alu2 <= '1';                -- OR

        -- R[RB] = R[RA] + INP2
        when ITYPE_ADDI2 =>
            c_rf1  <= '1'; c_rf2  <= '0'; c_wf1  <= '1'; -- Read RA, Write RB
            c_s(0) <= '0'; c_s(1) <= '1';                -- Mux1=RA, Mux2=INP2
            c_alu1 <= '0'; c_alu2 <= '0';                -- ADD

        -- R[RB] = R[RA] - INP2
        when ITYPE_SUBI2 =>
            c_rf1  <= '1'; c_rf2  <= '0'; c_wf1  <= '1'; -- Read RA, Write RB
            c_s(0) <= '0'; c_s(1) <= '1';                -- Mux1=RA, Mux2=INP2
            c_alu1 <= '0'; c_alu2 <= '1';                -- SUB

        -- R[RB] = R[RA] AND INP2
        when ITYPE_ANDI2 =>
            c_rf1  <= '1'; c_rf2  <= '0'; c_wf1  <= '1'; -- Read RA, Write RB
            c_s(0) <= '0'; c_s(1) <= '1';                -- Mux1=RA, Mux2=INP2
            c_alu1 <= '1'; c_alu2 <= '0';                -- AND
 
        -- R[RB] = R[RA] OR INP2
        when ITYPE_ORI2 =>
            c_rf1  <= '1'; c_rf2  <= '0'; c_wf1  <= '1'; -- Read RA, Write RB
            c_s(0) <= '0'; c_s(1) <= '1';                -- Mux1=RA, Mux2=INP2
            c_alu1 <= '1'; c_alu2 <= '1';                -- OR
   
        -- R[RB] = R[RA] (Performed as R[RA] + 0)
        when ITYPE_MOV =>
            c_rf1  <= '1'; c_rf2  <= '0'; c_wf1  <= '1'; -- Read RA, Write RB
            c_s(0) <= '0'; c_s(1) <= '1';                -- Mux1=RA, Mux2=INP2(0)
            c_alu1 <= '0'; c_alu2 <= '0';                -- ADD

        -- R[RB] = INP1
        when ITYPE_S_REG1 =>
            c_rf1  <= '0'; c_rf2  <= '0'; c_wf1  <= '1'; -- No Read, Write RB
            c_s(0) <= '1'; c_s(1) <= '0';                -- Mux1=INP1, Mux2=0
            c_alu1 <= '0'; c_alu2 <= '0';                -- Pass INP1

        -- R[RA] = INP2
        when ITYPE_S_REG2 =>
            c_rf1  <= '0'; c_rf2  <= '0'; c_wf1  <= '1'; -- No Read, Write RA
            c_s(0) <= '0'; c_s(1) <= '1';                -- Mux1=0, Mux2=INP2
            c_alu1 <= '0'; c_alu2 <= '0';                -- Pass INP2

        -- MEM[R[RA]+INP2] = R[RB]
	when ITYPE_S_MEM =>
		    c_rf1  <= '1'; c_rf2  <= '1'; c_wf1  <= '0'; -- Read RA(Base) and RB(Data), no RF Write
		    c_s(0) <= '0'; c_s(1) <= '1'; c_s(2) <= '0'; -- ALU=RA+INP2, Mux3=ALU
		    c_rm   <= '0'; c_wm   <= '1';                -- Enable Memory Write
		    c_alu1 <= '0'; c_alu2 <= '0';                -- ADD operation
	  
        -- R[RA] = MEM[R[RB]+INP1]
		when ITYPE_L_MEM1 =>
		    c_rf1  <= '0'; c_rf2  <= '1'; c_wf1  <= '1'; -- Read RB(Base), Write RA
		    c_s(0) <= '1'; c_s(1) <= '0'; c_s(2) <= '1'; -- ALU=INP1+RB, Mux3=MEM
		    c_rm   <= '1'; c_wm   <= '0';                -- Enable Memory Read
		    c_alu1 <= '0'; c_alu2 <= '0';                -- ADD operation

        -- R[RB] = MEM[R[RA]+INP2]
		when ITYPE_L_MEM2 =>
		    c_rf1  <= '1'; c_rf2  <= '0'; c_wf1  <= '1'; -- Read RA(Base), Write RB
		    c_s(0) <= '0'; c_s(1) <= '1'; c_s(2) <= '1'; -- ALU=RA+INP2, Mux3=MEM
		    c_rm   <= '1'; c_wm   <= '0';                -- Enable Memory Read
		    c_alu1 <= '0'; c_alu2 <= '0';                -- ADD operation

		when others =>
		    null;
	    end case;
	end process;

-- PROCESS 2: pipeline registers (sequential logic)
-- delays control signals by 1 or 2 clock cycles, for matching the datapath

CK: process(Clk, Rst)
begin 
    if (Rst='0') then
        -- Reset all pipeline FFs to 0
        r1_en2  <='0'; r1_en3  <= '0';  
        r1_s1   <= '0'; r1_s2   <= '0'; 
	r1_s3   <= '0';  
        r1_alu1 <= '0'; r1_alu2 <= '0';
        r1_wm   <= '0'; r1_rm   <= '0';
        r2_en3  <= '0'; r2_s3   <= '0';
        r2_wm   <= '0'; r2_rm   <= '0';

    elsif rising_edge(Clk) then    
        
        -- STAGE 2 (1 clock delay): load combinational signals into r1 registers
        r1_en2  <= c_en(1);
        r1_s1   <= c_s(0);
        r1_s2   <= c_s(1);
        r1_alu1 <= c_alu1;
        r1_alu2 <= c_alu2;

        -- STAGE 3 first step (1 clock delay): load comb. signals into r1 registers
        r1_en3  <= c_en(2);
        r1_s3   <= c_s(2);
        r1_rm   <= c_rm;
        r1_wm   <= c_wm;

        -- STAGE 3 second step (2 clock delay): move r1 signals to r2 registers
        r2_en3  <= r1_en3;
        r2_s3   <= r1_s3;
        r2_rm   <= r1_rm;
        r2_wm   <= r1_wm;
    end if;
end process;

    -- OUTPUT ASSIGNMENTS
    
    -- STAGE 1 outputs: sent directly, no delay
    EN1  <= c_en(0);
    RF1  <= c_rf1;
    RF2  <= c_rf2;
    WF1  <= c_wf1;

    -- STAGE 2 outputs: sent from the first pipe register (1 clock delay)
    EN2  <= r1_en2;
    S1   <= r1_s1;
    S2   <= r1_s2;
    ALU1 <= r1_alu1;
    ALU2 <= r1_alu2;

    -- STAGE 3 outputs: sent from the second pipe register (2 clock delay)
    EN3  <= r2_en3;
    S3   <= r2_s3;
    RM   <= r2_rm;
    WM   <= r2_wm;

end architecture;