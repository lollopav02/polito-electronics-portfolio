library ieee;

use ieee.std_logic_1164.all;

use ieee.std_logic_unsigned.all;



-- use WORK.constants.all; 



entity MULTIPLIER_tb is

end MULTIPLIER_tb;



architecture TEST of MULTIPLIER_tb is


  constant numBit : integer := 4; 



  signal A_mp_i : std_logic_vector(numBit-1 downto 0) := (others => '0');

  signal B_mp_i : std_logic_vector(numBit-1 downto 0) := (others => '0');

  signal Y_mp_i : std_logic_vector(2*numBit-1 downto 0);




  component BOOTHMUL is

    generic ( N : integer );

    port (

        A : in  std_logic_vector(N-1 downto 0);

        B : in  std_logic_vector(N-1 downto 0);

        P : out std_logic_vector(2*N-1 downto 0)

    );

  end component;



begin

  DUT: BOOTHMUL 

    generic map ( N => numBit )

    port map (

        A => A_mp_i,

        B => B_mp_i,

        P => Y_mp_i

    );


  test: process

  begin

    A_mp_i <= (others => '0');

    B_mp_i <= (others => '0');

    wait for 10 ns;


    NumROW : for i in 0 to 2**(numBit)-1 loop		-- A Cicle

        NumCOL : for j in 0 to 2**(numBit)-1 loop	-- B Cicle

            wait for 10 ns;

            B_mp_i <= B_mp_i + '1';

        end loop NumCOL ;

        A_mp_i <= A_mp_i + '1';     

    end loop NumROW ;

    wait;          

  end process test;

end TEST;
