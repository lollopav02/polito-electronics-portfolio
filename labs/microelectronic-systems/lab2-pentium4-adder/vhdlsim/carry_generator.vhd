library ieee;
use ieee.std_logic_1164.all;
use ieee.numeric_std.all;

entity CARRY_GENERATOR is
	generic (
		NBIT           : integer := 32;
		NBIT_PER_BLOCK : integer := 4
	);
	port (
		A   : in  std_logic_vector(NBIT-1 downto 0);
		B   : in  std_logic_vector(NBIT-1 downto 0);
		Cin : in  std_logic;
		Co  : out std_logic_vector((NBIT/NBIT_PER_BLOCK)-1 downto 0)
	);
end CARRY_GENERATOR;

architecture STRUCTURAL of CARRY_GENERATOR is
	component PG_NET_BLOCK
	        port ( A, B : in std_logic; p, g : out std_logic );
	end component;

	component G_BLOCK
		port ( Pik, Gik, Gkj : in std_logic; Gij : out std_logic );
	end component;

	component PG_BLOCK
		port ( Pik, Gik, Pkj, Gkj : in std_logic; Pij, Gij : out std_logic );
	end component;

	type SignalVector is array (NBIT downto 0) of std_logic_vector(NBIT downto 0);
	
	signal P_matrix : SignalVector;
	signal G_matrix : SignalVector;
	
	begin
	
	righe: for riga in 0 to NBIT-1 generate

		riga0: if riga = 0 generate --row 0 have a specific structure different from the other ones
			colonne0: for colonna in 0 to NBIT generate            
				gen_cin: if colonna = 0 generate
					P_matrix(0)(0) <= '0';
					G_matrix(0)(0) <= Cin;
				end generate;
			
				gen_pg: if colonna > 0 generate
					PG_NET: PG_NET_BLOCK port map (
						A => A(colonna-1), B => B(colonna-1),
						p => P_matrix(0)(colonna), g => G_matrix(0)(colonna)
						);
				end generate;
			end generate colonne0;
		end generate riga0;
			
	        riga_n: if riga > 0 generate -- riga after the 0th one are generalizable
			tree_active: if (2**(riga-1) <= NBIT) generate -- rows under the 2 to the power of row minus one are connected to the tree
				colonne: for colonna in 0 to NBIT generate                    
					pass_cin: if colonna = 0 generate
						P_matrix(riga)(0) <= '0';
						G_matrix(riga)(0) <= G_matrix(riga-1)(0);
					end generate;
			
					connect: if colonna > 0 generate                        
						pass_wire: if colonna < 2**(riga-1) generate
							P_matrix(riga)(colonna) <= P_matrix(riga-1)(colonna);
							G_matrix(riga)(colonna) <= G_matrix(riga-1)(colonna);
						end generate;
					
						do_block: if colonna >= 2**(riga-1) generate
							use_g: if (colonna - 2**(riga-1)) = 0 generate
								G_INST: G_BLOCK port map (
									Pik => P_matrix(riga-1)(colonna),
									Gik => G_matrix(riga-1)(colonna),
									Gkj => G_matrix(riga-1)(0),
									Gij => G_matrix(riga)(colonna)
									);
								P_matrix(riga)(colonna) <= '0';
							end generate;
			
							use_pg: if (colonna - 2**(riga-1)) > 0 generate
								PG_INST: PG_BLOCK port map (
									Pik => P_matrix(riga-1)(colonna),
									Gik => G_matrix(riga-1)(colonna),
									Pkj => P_matrix(riga-1)(colonna - 2**(riga-1)),
									Gkj => G_matrix(riga-1)(colonna - 2**(riga-1)),
									Pij => P_matrix(riga)(colonna),
									Gij => G_matrix(riga)(colonna)
									);
							end generate;
						end generate do_block;
					end generate connect;
				end generate colonne;
			end generate tree_active;
			
			tree_inactive: if (2**(riga-1) > NBIT) generate -- rows over the 2 to the power of row minus one must be connected to the following stage of the tree
				copy_row: for colonna in 0 to NBIT generate
					P_matrix(riga)(colonna) <= P_matrix(riga-1)(colonna);
					G_matrix(riga)(colonna) <= G_matrix(riga-1)(colonna);
				end generate;
			end generate tree_inactive;
		end generate riga_n;
	end generate righe;
 
	output_gen: for i in 0 to (NBIT/NBIT_PER_BLOCK)-1 generate -- connecting carry output to the block output
	        Co(i) <= G_matrix(NBIT-1)(((i+1) * NBIT_PER_BLOCK));
	end generate output_gen;
end STRUCTURAL;
