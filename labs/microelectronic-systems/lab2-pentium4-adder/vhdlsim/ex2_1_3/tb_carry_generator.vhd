library ieee; 
use ieee.std_logic_1164.all;
use ieee.std_logic_unsigned.all;

entity TB_CARRY_GENERATOR is 
end TB_CARRY_GENERATOR; 

architecture TEST of TB_CARRY_GENERATOR is
    component CARRY_GENERATOR is
        generic (
            NBIT: integer := 32;
            NBIT_PER_BLOCK: integer := 4
        );
        port (
            A : in  std_logic_vector(NBIT-1 downto 0);
            B : in  std_logic_vector(NBIT-1 downto 0);
            Cin : in  std_logic;
            Co : out std_logic_vector((NBIT/NBIT_PER_BLOCK)-1 downto 0)
        );
    end component;

    -- Costants

    constant NBIT_TEST : integer := 32;
    constant BLK_SIZE  : integer := 4;
    constant NUM_OUTS  : integer := NBIT_TEST / BLK_SIZE; -- 8 uscite di carry

    -- Signals

    signal A_tb   : std_logic_vector(NBIT_TEST-1 downto 0) := (others => '0');
    signal B_tb   : std_logic_vector(NBIT_TEST-1 downto 0) := (others => '0');
    signal Cin_tb : std_logic := '0';
    signal Co_tb  : std_logic_vector(NUM_OUTS-1 downto 0);

begin
    -- Device Under Test (DUT)

    UUT: CARRY_GENERATOR

        generic map (
            NBIT => NBIT_TEST,
            NBIT_PER_BLOCK => BLK_SIZE
        )
        port map (
            A => A_tb,
            B => B_tb,
            Cin => Cin_tb,
            Co => Co_tb
        );

    STIMULUS: process			-- Stimulus process
    begin


        A_tb   <= x"00000000";		-- Case 1: No Carry
        B_tb   <= x"00000000";
        Cin_tb <= '0';
        wait for 10 ns; 		-- Expected Co: 00000000 (Binary)


        A_tb   <= x"FFFFFFFF";		-- Case 2: Total Carry In Propagation (All bits at '1' + Carry In)
        B_tb   <= x"00000000";		-- A=FFFFFFFF, B=00000000, Cin=1 -> carry should be propagated
        Cin_tb <= '1';
        wait for 10 ns; 		-- Expected Co: 11111111 (All sparse node should have Cout = '1')


        A_tb   <= x"0000000F";		-- Case 3: Specific Carry In Generation
        B_tb   <= x"00000001";		-- We set A and B to 1 in the first 4-bit block. This generates a carry that goes into the next block.
        Cin_tb <= '0';
        wait for 10 ns; 		-- Expected: A carry is generated from bit 0, propagating to bit 4.


        A_tb   <= x"AAAAAAAA";		-- Case 4: Alternation
        B_tb   <= x"55555555";
        Cin_tb <= '1';
        wait for 10 ns;

        wait;

    end process STIMULUS;
end TEST;